/*
 * Copyright (c) 2022 Advanced Micro Devices, Inc. (AMD)
 *
 * SPDX-License-Identifier: Apache-2.0
 */

/dts-v1/;

/ {
	cpus: cpus {
		#address-cells = <1>;
		#cpus = <0x1>;
		#size-cells = <0>;
	};

	amba_root: amba_root {
		#address-cells = <2>;
		#size-cells = <2>;
		#priority-cells = <1>;

		amba: amba {
			compatible = "simple-bus";
		};
	};
};

#include "microblaze-zephyr-demo-env.dtsi"
