## arch/microblaze/Kconfig.cache
```kconfig
# Copyright 2022 Advanced Micro Devices, Inc. (AMD)
# SPDX-License-Identifier: Apache-2.0


menu "Cache Options"
	depends on MICROBLAZE

config DCACHE_USE_WRITEBACK_SUPPORTED
	def_bool y
	help
		This needs to be set by user because it's difficult to make Kconfig or precompiler
		make this decision based on CPU_VERSION. This config flag indicates the lack of
		DCACHE_USE_WRITEBACK capability with MicroBlaze CPUs with version less than 7.2.0.


config MICROBLAZE_DCACHE_USE_WRITEBACK
	def_bool y
	depends on DCACHE_USE_WRITEBACK_SUPPORTED
	help
		This should come from dts. Default value is copied manually from xparameters
		If this isn't defined in your xparameters you're likely using a MicroBlaze
		with cpu version less than 7.2.0. If so, unset DCACHE_USE_WRITEBACK_SUPPORTED
		in your SoC Kconfig or defconfigs.

config MICROBLAZE_DCACHE_HIGHADDR
	def_hex 0x7FFFFFFF
	help
		This should come from dts. Default value is copied manually from xparameters
config MICROBLAZE_DCACHE_BASEADDR
	def_hex 0x00000000
	help
		This should come from dts. Default value is copied manually from xparameters

config MICROBLAZE_ALLOW_DCACHE_WR
	def_bool y
	help
		This should come from dts. Default value is copied manually from xparameters

config CONFIG_MICROBLAZE_USE_DCACHE
	def_bool y
	help
		This should come from dts. Default value is copied manually from xparameters

config CONFIG_MICROBLAZE_USE_ICACHE
	def_bool y
	help
		This should come from dts. Default value is copied manually from xparameters

config MICROBLAZE_ALLOW_ICACHE_WR
	def_bool y
	help
		This should come from dts. Default value is copied manually from xparameters

config MICROBLAZE_INTERCONNECT
	def_int 2
	help
		This should come from dts. Default value is copied manually from xparameters

config MICROBLAZE_DCACHE_BYTE_SIZE
	def_int 32768
	help
		This should come from dts. Default value is copied manually from xparameters

config MICROBLAZE_ICACHE_BYTE_SIZE
	def_int 32768
	help
		This should come from dts. Default value is copied manually from xparameters
		Extra note: XPAR_ICACHE_BYTE_SIZE doesn't exist but XPAR_MICROBLAZE_CACHE_BYTE_SIZE exists.

config MICROBLAZE_ICACHE_LINE_LEN
	def_int 16
	help
		This should come from dts. Default value is copied manually from xparameters

config MICROBLAZE_DCACHE_LINE_LEN
	def_int 16
	help
		This should come from dts. Default value is copied manually from xparameters

config MICROBLAZE_EXT_CACHE_LINE_LEN
	def_int 16
	help
		This should come from dts. Default value is copied manually from xparameters

endmenu
```

## arch/microblaze/Kconfig.compiler
```kconfig
# Copyright 2022 Advanced Micro Devices, Inc. (AMD)
# SPDX-License-Identifier: Apache-2.0


menu "Compiler and Build Options"
	depends on MICROBLAZE

config DATA_IS_TEXT_RELATIVE
	bool "Assume data & text segment distance is static"
	default y
	help
		Assume that the displacement between the text and data segments is fixed at
		static link time. This allows data to be referenced by offset from start of
		text address instead of GOT since PC-relative addressing is not supported.
		Injects -mpic-data-is-text-relative

config GENERATE_EXTENDED_DISASSEMBLY
	bool "Generate a listing file that contains both the dissassembly & map"
	default y
	help
		Also see KConfig option OUTPUT_DISASSEMBLE_ALL

config DEBUG_NO_OPT
	bool "Disable optimisations for debugging"
	default y
	select DEBUG
	help
		Injects -fno-inline and -fno-optimize-sibling-calls if set,
		otherwise injects -fomit-frame-pointer. Also force selects DEBUG

endmenu
```

## arch/microblaze/Kconfig.features
```kconfig
# Copyright 2022 Advanced Micro Devices, Inc. (AMD)
# SPDX-License-Identifier: Apache-2.0


menu "HW Feature Options"
	depends on MICROBLAZE

config MICROBLAZE_USE_FPU
	def_bool n
	select CPU_HAS_FPU if MICROBLAZE_USE_FPU
	help
		This should come from dts. Default value is copied manually from xparameters

config MICROBLAZE_USE_MSR_INSTR
	prompt "Use msrset & msrclr instructions"
	def_bool y
	help
		This should come from dts. Default value is copied manually from xparameters

config HAS_BARREL_SHIFT_INSTR
	prompt "Use barrel shift instructions"
	def_bool y
	help
		This should come from dts. Default value is copied manually from xparameters

config HAS_PATTERN_COMPARE_INSTR
	prompt "Use pattern compare instructions"
	def_bool y
	help
		This should come from dts. Default value is copied manually from xparameters

config HAS_DIV_INSTR
	prompt "Use division instructions"
	def_bool y
	help
		This should come from dts. Default value is copied manually from xparameters

config HAS_MUL_INSTR
	prompt "Use multiplication instructions"
	def_bool y
	help
		This should come from dts. Default value is copied manually from xparameters

config HAS_MULHI_INSTR
	prompt "Use mulhi for multiplication of higher bits"
	def_bool y
	depends on HAS_MUL_INSTR
	help
		Use multiply high instructions for high part of 32x32 multiply.
		This should come from dts. Default value is copied manually from xparameters

config USE_HARDWARE_FLOAT_INSTR
	def_bool n
	depends on CPU_HAS_FPU
	help
		Use hardware floating-point instructions.
		This should come from dts. Default value is copied manually from xparameters

config MICROBLAZE_USE_STACK_PROTECTION
	def_bool n
	help
		This should come from dts. Default value is copied manually from xparameters

endmenu
```

## boards/microblaze/qemu_microblaze/Kconfig.defconfig
```kconfig
# Copyright 2022 Advanced Micro Devices, Inc. (AMD)
# SPDX-License-Identifier: Apache-2.0


if BOARD_QEMU_MICROBLAZE

config BOARD
	default "qemu_microblaze"

endif # BOARD_QEMU_MICROBLAZE
```

## boards/microblaze/qemu_microblaze/qemu_microblaze_defconfig
```kconfig
# Copyright 2022 Advanced Micro Devices, Inc. (AMD)
# SPDX-License-Identifier: Apache-2.0


CONFIG_SOC_XLNX_MICROBLAZE_DEMO=y
CONFIG_BOARD_QEMU_MICROBLAZE=y
CONFIG_UART_XLNX_UARTLITE=y
CONFIG_UART_INTERRUPT_DRIVEN=y
CONFIG_SERIAL=y
CONFIG_CONSOLE=y
CONFIG_UART_CONSOLE=y
CONFIG_EXTRA_EXCEPTION_INFO=y
CONFIG_QEMU_ICOUNT=n
```

## drivers/timer/Kconfig.xlnx_tmrctr
```kconfig
# Copyright 2022 Advanced Micro Devices, Inc. (AMD)
# SPDX-License-Identifier: Apache-2.0



if MICROBLAZE

config XLNX_TMRCTR
	bool "Xilinx AXI Timer/Counter"
	default y
	depends on MICROBLAZE
	help
		This module implements a kernel device driver for the MICROBLAZE AXI Timer devices.

config XLNX_TMRCTR_TIMER_INDEX
	int "Xilinx TMRCTR timer index"
	default 0
	depends on XLNX_TMRCTR
	help
		This is the index of timer/counter picked to provide system clock.

endif # MICROBLAZE
```

## dts/bindings/cpu/xlnx,microblaze.yaml
```yaml
# Copyright 2022 Advanced Micro Devices, Inc. (AMD)
# SPDX-License-Identifier: Apache-2.0


description: AMD Xilinx MicroBlaze

compatible: "xlnx,microblaze"

include: cpu.yaml
```

## dts/bindings/interrupt-controller/xlnx,intc.yaml
```yaml
# Copyright 2022 Advanced Micro Devices, Inc. (AMD)
# SPDX-License-Identifier: Apache-2.0


description: Xilinx AXI Interrupt Controller

compatible: "xlnx,intc"

include: [interrupt-controller.yaml, base.yaml]

properties:
  reg:
    required: true

  "#interrupt-cells":
      const: 2

interrupt-cells:
  - irq
  - priority
```

## dts/bindings/sram/xlnx,bram.yaml
```yaml
# Copyright 2022 Advanced Micro Devices, Inc. (AMD)
# SPDX-License-Identifier: Apache-2.0


description: Xilinx Block RAM Memory Device

compatible: "xlnx,bram"

include: mmio-sram.yaml

properties:
  write-access:
    type: int
    required: true
    description: Write access enable value
```

## dts/bindings/timer/xlnx,tmrctr.yaml
```yaml
# Copyright 2022 Advanced Micro Devices, Inc. (AMD)
# SPDX-License-Identifier: Apache-2.0

description: Xilinx AXI TMRCTR timer counter

compatible: "xlnx,tmrctr"

include: base.yaml

properties:
  reg:
    required: true

  clock-frequency:
    type: int
    required: true
    description: Clock frequency information for Timer operation
```

## soc/microblaze/microblaze_demo/Kconfig.soc
```kconfig
# Copyright 2022 Advanced Micro Devices, Inc. (AMD)
# SPDX-License-Identifier: Apache-2.0


config SOC_XLNX_MICROBLAZE_DEMO
	bool "Xilinx MicroBlaze Demo SoC Configuration"
	select MICROBLAZE
	select XLNX_INTC
	select XLNX_TMRCTR
```

## tests/kernel/mem_protect/stackprot/testcase.yaml
```yaml
tests:
  kernel.memory_protection.stackprot:
    arch_exclude: nios2 xtensa posix sparc microblaze
    tags: kernel ignore_faults userspace
```
